## board/ti/am3352_eissbox3/Kconfig
```kconfig
if TARGET_AM3352_EISSBOX3

config SYS_BOARD
	default "am3352_eissbox3"

config SYS_VENDOR
	default "ti"

config SYS_SOC
	default "am33xx"

config SYS_CONFIG_NAME
	default "am3352_eissbox3"

config EISSBOX3_COMMON_CMD_OPTIONS
	bool "Enable cmd options on EISSBOX3 board"
	imply CMD_ASKENV
	imply CMD_BOOTZ
	imply CRC32_VERIFY if ARCH_KEYSTONE
	imply CMD_DFU if USB_GADGET_DOWNLOAD
	imply CMD_DHCP
	imply CMD_EEPROM
	imply CMD_EXT2
	imply CMD_EXT4
	imply CMD_EXT4_WRITE
	imply CMD_FAT
	imply FAT_WRITE if CMD_FAT
	imply CMD_FS_GENERIC
	imply CMD_GPIO
	imply CMD_GPT
	imply CMD_I2C
	imply CMD_MII
	imply CMD_MMC
	imply CMD_PART
	imply CMD_PING
	imply CMD_PMIC if DM_PMIC
	imply CMD_REGULATOR if DM_REGULATOR
	imply CMD_TIME
	imply CMD_USB if USB

endif
```

## configs/am3352_eissbox3_defconfig
```kconfig
# Architecture
CONFIG_ARM=y
CONFIG_AM33XX=y
CONFIG_ARCH_OMAP2PLUS=y
CONFIG_TARGET_AM3352_EISSBOX3=y
CONFIG_SYS_I2C_BUS_MAX=2

# General
CONFIG_SYS_PROMPT="E-Box3# "
CONFIG_IDENT_STRING=" EISSBox3"
CONFIG_DISTRO_DEFAULTS=y
CONFIG_ARCH_MISC_INIT=y
CONFIG_MMC_OMAP_HS=y
CONFIG_DRIVER_TI_CPSW=y

# Console
CONFIG_LOG=y
CONFIG_LOGLEVEL=1
CONFIG_SPL_LOG=y
CONFIG_SPL_LOGLEVEL=1


# Boot
CONFIG_SD_BOOT=y
CONFIG_EMMC_BOOT=y
CONFIG_USE_BOOTCOMMAND=y
CONFIG_BOOTCOMMAND="run envboot"
CONFIG_BOOTP_PREFER_SERVERIP=y
CONFIG_SYS_MMCSD_RAW_MODE_U_BOOT_USE_PARTITION=y
CONFIG_SYS_MMCSD_RAW_MODE_U_BOOT_PARTITION=0x1
CONFIG_SYS_MMCSD_RAW_MODE_U_BOOT_USE_PARTITION_TYPE=y
CONFIG_SYS_MMCSD_RAW_MODE_U_BOOT_PARTITION_TYPE=0x01


# Autoboot options
CONFIG_BOOTDELAY=1
CONFIG_AUTOBOOT=y
CONFIG_AUTOBOOT_KEYED=y
CONFIG_AUTOBOOT_PROMPT="Press S key to abort autoboot in %d seconds\n"
CONFIG_AUTOBOOT_DELAY_STR="d"
CONFIG_AUTOBOOT_STOP_STR="s"

# SPL
CONFIG_SPL=y
CONFIG_SPL_BUILD=y
CONFIG_SPL_MMC_SUPPORT=y
CONFIG_SPL_SERIAL_SUPPORT=y
CONFIG_SPL_FAT_SUPPORT=y
CONFIG_SPL_FS_FAT=y
CONFIG_SPL_FS_EXT4=y
CONFIG_SPL_NAND_SUPPORT=n # NAND Flash memory is NOT supported

# Libraries
CONFIG_OF_LIBFDT=y
CONFIG_SPL_LIBDISK_SUPPORT=y

# Command line interface
CONFIG_EISSBOX3_COMMON_CMD_OPTIONS=y
CONFIG_CMDLINE=y
CONFIG_HUSH_PARSER=y

# USB peripherals
CONFIG_USB=y
CONFIG_USB_MUSB_HOST=y
CONFIG_USB_MUSB_GADGET=y
CONFIG_USB_MUSB_DSPS=y
CONFIG_USB_STORAGE=y
CONFIG_USB_GADGET=y
CONFIG_USB_GADGET_MANUFACTURER="Texas Instruments"
CONFIG_USB_GADGET_VENDOR_NUM=0x0451
CONFIG_USB_GADGET_PRODUCT_NUM=0xd022
CONFIG_USB_ETHER=y
CONFIG_USBNET_HOST_ADDR="de:ad:be:af:00:00"
CONFIG_USBNET_DEVADDR="de:ad:be:ef:00:01"

# Watchdog Timer Support
CONFIG_HW_WATCHDOG=y
CONFIG_OMAP_WATCHDOG=y
CONFIG_WATCHDOG_TIMEOUT_MSECS=60000
```
